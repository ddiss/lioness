## buildroot-external/package/lioness/Config.in
```kconfig
config BR2_PACKAGE_LIONESS
	bool "lioness"
	depends on BR2_PACKAGE_HOST_RUSTC_TARGET_ARCH_SUPPORTS
	select BR2_PACKAGE_HOST_RUSTC
	help
	  Lioness provides user-unlock functionality for a (dm-crypt)
	  encrypted storage area, subsequently exposed as a USB
	  mass-storage device.
```

## buildroot-external/package/softfido/Config.in
```kconfig
config BR2_PACKAGE_SOFTFIDO
	bool "softfido"
	depends on BR2_PACKAGE_HOST_RUSTC_TARGET_ARCH_SUPPORTS
	select BR2_PACKAGE_HOST_RUSTC
	select BR2_PACKAGE_SOFTHSM2
	help
	  Softfido is a software implementation of a FIDO2/U2F
	  authenticator. Most FIDO2 authenticators are based on hardware
	  like USB sticks or TPM-like chips in smartphones. Softfido
	  instead implements a virtual USB device (via USBIP) so that
	  webbrowsers can talk to it.

	  https://github.com/ellerh/softfido
```
